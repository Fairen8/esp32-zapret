## components/esp_desync/Kconfig
```kconfig
# SPDX-License-Identifier: MIT
menu "esp_desync anti-DPI"

    choice ESP_DESYNC_DEFAULT_MODE
        prompt "Default desync mode"
        default ESP_DESYNC_MODE_FAKE_SPLIT
        help
            fake+split is the closest match to zapret's classic
            "--dpi-desync=fake,split2" strategy.

            OFF         - no modification (plain TLS)
            SPLIT       - split ClientHello into TCP segments
            DISORDER    - send tail of ClientHello first (raw), head via socket
            FAKE        - send decoy ClientHello via raw IP with low TTL, then real
            FAKE_SPLIT  - FAKE + SPLIT (recommended default)
            TLSREC      - split ClientHello into two TLS records
            SEQOVL      - inject the fake shifted back so it overlaps the head
    config ESP_DESYNC_MODE_OFF
        bool "OFF"
    config ESP_DESYNC_MODE_SPLIT
        bool "SPLIT"
    config ESP_DESYNC_MODE_DISORDER
        bool "DISORDER"
    config ESP_DESYNC_MODE_FAKE
        bool "FAKE"
    config ESP_DESYNC_MODE_FAKE_SPLIT
        bool "FAKE_SPLIT"
    config ESP_DESYNC_MODE_TLSREC
        bool "TLSREC"
    config ESP_DESYNC_MODE_SEQOVL
        bool "SEQOVL"
    endchoice

    config ESP_DESYNC_FAKE_SNI
        string "Decoy SNI for fake ClientHello"
        default "www.iana.org"
        help
            TSPU must classify this domain as allowed. iana.org is
            zapret's built-in default. If it ever gets blocked, change
            to any popular non-blocked domain of your ISP.

    config ESP_DESYNC_FAKE_TTL
        int "TTL for injected fake packets"
        range 1 255
        default 3
        help
            The fake must reach the DPI/TSPU but die before the real
            server. Tune it: find the minimal TTL at which the bypass
            still works - that is the hop number of your DPI.

    config ESP_DESYNC_FAKE_REPEATS
        int "Fake packet repeats"
        range 1 8
        default 1

    config ESP_DESYNC_OP_DELAY_MS
        int "Delay between desync operations (ms)"
        range 0 1000
        default 20

    config ESP_DESYNC_SPLIT_POS
        int "Split position (-1 = auto, inside SNI)"
        default -1

    choice ESP_DESYNC_FOOLING
        prompt "Fake packet fooling method"
        default ESP_DESYNC_FOOLING_TTL
        help
            How the fake packet is prevented from reaching the server.

            TTL    - packet dies on the way (most universal, needs tuning).
            MD5SIG - TCP MD5 signature option; Linux servers silently drop it.
            BADSUM - broken TCP checksum; home routers with conntrack
                     checksum verification usually drop the packet too.
            BADSEQ - sequence number pushed out of window.
            TS     - TCP timestamps option with a random value (can be
                     combined with TTL via /fool or the web UI).

    config ESP_DESYNC_FOOLING_TTL
        bool "TTL"
    config ESP_DESYNC_FOOLING_MD5SIG
        bool "MD5SIG"
    config ESP_DESYNC_FOOLING_BADSUM
        bool "BADSUM"
    config ESP_DESYNC_FOOLING_BADSEQ
        bool "BADSEQ"
    config ESP_DESYNC_FOOLING_TS
        bool "TS"
    endchoice

    config ESP_DESYNC_BADSEQ_OFFSET
        int "BADSEQ sequence offset"
        default -10000

    config ESP_DESYNC_SEQOVL_LEN
        int "SEQOVL: bytes to shift the fake sequence number back"
        range 1 512
        default 32

endmenu
```

## main/Kconfig.projbuild
```kconfig
menu "esp32-zapret application"

    config APP_ENABLE_TELEGRAM_BOT
        bool "Telegram bot (commands and Wake-on-LAN)"
        default y
        help
            Enable the Telegram bot: long polling, commands (/wake, /status,
            /desync, /ttl, /fool) and Wake-on-LAN.

            Disable to build the "no bot" variant: the device performs a
            periodic TLS self-test through esp_desync to api.telegram.org and
            logs the result over serial. Useful for verifying the bypass on a
            network without configuring a bot token.

    config APP_SCAN_ON_BOOT
        bool "Auto-detect the optimal desync strategy at boot"
        default y
        help
            Probes the saved strategy first, then a list of candidates
            (fake/split/disorder/tlsrec with different TTLs and decoy SNIs)
            and stores the first working one in NVS.

    config APP_HEALTH_CHECK_INTERVAL_S
        int "Bypass health-check interval (seconds)"
        default 600
        range 60 86400

    config APP_HEALTH_FAIL_THRESHOLD
        int "Consecutive health-check failures before re-scan"
        default 2
        range 1 10

    config APP_DOH_FALLBACK
        bool "DNS-over-HTTPS fallback resolver (Cloudflare/Google)"
        default y

    config APP_SNTP_SERVERS
        string "SNTP servers (comma-separated, tried in order)"
        default "pool.ntp.org,time.google.com,time.cloudflare.com"
        help
            Up to CONFIG_LWIP_SNTP_MAX_SERVERS entries are used. Extra
            entries are ignored; a single unreachable server no longer
            blocks the clock forever.

    config APP_SNTP_TIMEOUT_S
        int "Seconds to wait for SNTP before falling back to the build timestamp"
        default 90
        range 10 3600
        help
            After this timeout the firmware sets the clock from its own
            build date/time so TLS can start even when NTP is blocked.

    config APP_WEB_UI
        bool "Web UI (setup access point and settings page)"
        default y
        help
            HTTP server for first-time provisioning and for changing
            settings at runtime. When the device is not configured, it
            starts its own Wi-Fi access point (no HTTP auth needed, the AP
            is password protected). Once provisioned, the same page is
            served on the local network behind HTTP Basic auth (user
            "admin", password = web password).

    config APP_WEB_PASSWORD
        string "Default setup/web password (at least 8 characters)"
        default "zapret12345"
        help
            WPA2 password of the setup access point and the HTTP Basic
            password of the settings page. Can be changed in the web UI or
            over the serial console; stored in NVS.

    config APP_SETUP_AP_PREFIX
        string "Setup access point name prefix"
        default "esp32-zapret"

    config APP_STATS_DEFAULT_ON
        bool "Anonymous statistics enabled by default (opt-out)"
        default y
        help
            Sends a small anonymous report (firmware version, chip, uptime,
            heap, RSSI, selected bypass strategy and its counters) to
            statistics.fairen8.ru.

            No identifiers are sent: no device or chat IDs, no SSIDs, no IP
            addresses. Enabled by default; can be disabled at runtime with the
            /stats bot command or in the web UI, or at build time by setting
            this option to n. Reports are best-effort and failures are never
            reported to the user.

    config APP_STATS_INTERVAL_S
        int "Anonymous statistics interval (seconds)"
        default 86400
        range 3600 604800

    config APP_STATS_HOST
        string "Anonymous statistics endpoint"
        default "statistics.fairen8.ru"

endmenu
```
